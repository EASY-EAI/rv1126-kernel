

//由于jd9365d与jd9365da chip id相同，因此不能在loader中选择其一来使用，此处要修改jd9365da的init seq来加载jd9365d的init code
&dsi {
	panel@0 {
		panel-init-sequence-jd9365da = [ //jd9365d actually
			15 00 02 E0 00

			15 00 02 E1 93
			15 00 02 E2 65
			15 00 02 E3 F8
			15 00 02 80 03

			15 00 02 E0 01

			15 00 02 00 00
			15 00 02 01 3C
			15 00 02 03 00
			15 00 02 04 3C

			15 00 02 0C 74
			15 00 02 17 00
			15 00 02 18 F7
			15 00 02 19 01
			15 00 02 1A 00
			15 00 02 1B F7
			15 00 02 1C 01

			15 00 02 24 F1

			15 00 02 35 23

			15 00 02 37 09

			15 00 02 38 04
			15 00 02 39 00
			15 00 02 3A 01
			15 00 02 3C 70
			15 00 02 3D FF
			15 00 02 3E FF
			15 00 02 3F 7F

			15 00 02 40 06
			15 00 02 41 A0
			15 00 02 43 1E
			15 00 02 44 0B
			15 00 02 45 28

			15 00 02 55 01
			15 00 02 57 A9
			15 00 02 59 0A
			15 00 02 5A 2D
			15 00 02 5B 1A
			15 00 02 5C 15

			15 00 02 5D 7F
			15 00 02 5E 69
			15 00 02 5F 59
			15 00 02 60 4C
			15 00 02 61 47
			15 00 02 62 38
			15 00 02 63 3D
			15 00 02 64 27
			15 00 02 65 41
			15 00 02 66 40
			15 00 02 67 40
			15 00 02 68 5B
			15 00 02 69 46
			15 00 02 6A 49
			15 00 02 6B 3A
			15 00 02 6C 34
			15 00 02 6D 25
			15 00 02 6E 15
			15 00 02 6F 02
			15 00 02 70 7F
			15 00 02 71 69
			15 00 02 72 59
			15 00 02 73 4C
			15 00 02 74 47
			15 00 02 75 38
			15 00 02 76 3D
			15 00 02 77 27
			15 00 02 78 41
			15 00 02 79 40
			15 00 02 7A 40
			15 00 02 7B 5B
			15 00 02 7C 46
			15 00 02 7D 49
			15 00 02 7E 3A
			15 00 02 7F 34
			15 00 02 80 25
			15 00 02 81 15
			15 00 02 82 02

			15 00 02 E0 02

			15 00 02 00 50
			15 00 02 01 5F
			15 00 02 02 5F
			15 00 02 03 52
			15 00 02 04 77
			15 00 02 05 57
			15 00 02 06 5F
			15 00 02 07 4E
			15 00 02 08 4C
			15 00 02 09 5F
			15 00 02 0A 4A
			15 00 02 0B 48
			15 00 02 0C 5F
			15 00 02 0D 46
			15 00 02 0E 44
			15 00 02 0F 40
			15 00 02 10 5F
			15 00 02 11 5F
			15 00 02 12 5F
			15 00 02 13 5F
			15 00 02 14 5F
			15 00 02 15 5F

			15 00 02 16 51
			15 00 02 17 5F
			15 00 02 18 5F
			15 00 02 19 53
			15 00 02 1A 77
			15 00 02 1B 57
			15 00 02 1C 5F
			15 00 02 1D 4F
			15 00 02 1E 4D
			15 00 02 1F 5F
			15 00 02 20 4B
			15 00 02 21 49
			15 00 02 22 5F
			15 00 02 23 47
			15 00 02 24 45
			15 00 02 25 41
			15 00 02 26 5F
			15 00 02 27 5F
			15 00 02 28 5F
			15 00 02 29 5F
			15 00 02 2A 5F
			15 00 02 2B 5F

			15 00 02 2C 01
			15 00 02 2D 1F
			15 00 02 2E 1F
			15 00 02 2F 13
			15 00 02 30 17
			15 00 02 31 17
			15 00 02 32 1F
			15 00 02 33 0D
			15 00 02 34 0F
			15 00 02 35 1F
			15 00 02 36 05
			15 00 02 37 07
			15 00 02 38 1F
			15 00 02 39 09
			15 00 02 3A 0B
			15 00 02 3B 11
			15 00 02 3C 1F
			15 00 02 3D 1F
			15 00 02 3E 1F
			15 00 02 3F 1F
			15 00 02 40 1F
			15 00 02 41 1F

			15 00 02 42 00
			15 00 02 43 1F
			15 00 02 44 1F
			15 00 02 45 12
			15 00 02 46 17
			15 00 02 47 17
			15 00 02 48 1F
			15 00 02 49 0C
			15 00 02 4A 0E
			15 00 02 4B 1F
			15 00 02 4C 04
			15 00 02 4D 06
			15 00 02 4E 1F
			15 00 02 4F 08
			15 00 02 50 0A
			15 00 02 51 10
			15 00 02 52 1F
			15 00 02 53 1F
			15 00 02 54 1F
			15 00 02 55 1F
			15 00 02 56 1F
			15 00 02 57 1F

			15 00 02 58 40
			15 00 02 5B 10
			15 00 02 5C 06
			15 00 02 5D 40
			15 00 02 5E 00
			15 00 02 5F 00
			15 00 02 60 40
			15 00 02 61 03
			15 00 02 62 04
			15 00 02 63 6C
			15 00 02 64 6C
			15 00 02 65 75
			15 00 02 66 08
			15 00 02 67 B4
			15 00 02 68 08
			15 00 02 69 6C
			15 00 02 6A 6C
			15 00 02 6B 0C
			15 00 02 6D 00
			15 00 02 6E 00
			15 00 02 6F 88
			15 00 02 75 BB
			15 00 02 76 00
			15 00 02 77 05
			15 00 02 78 2A

			15 00 02 E0 04
			15 00 02 09 11
			15 00 02 0E 48
			15 00 02 2B 08
			15 00 02 2D 03
			15 00 02 2E 03

			15 00 02 E0 00

			15 78 02 11 00
			15 05 02 29 00
		];
	};
};
